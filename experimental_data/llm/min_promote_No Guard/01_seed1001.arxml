AUTOSAR XML (schema 4-2-2)
package /ComponentTypes
  application sw component type ASW_COM_MIN
    provide port MCU01_EmergShutDown: nonqueued-sender-com-spec=MCU01_EmergShutDown, provided-interface=SR_Interface_MCU01_EmergShutDown
