AUTOSAR XML (schema 4-2-2)
package /ComponentTypes
  application sw component type ASW_COM_MIN
    provide port PPort_MCU03_NRF_IdcSamp: nonqueued-sender-com-spec=MCU03_NRF_IdcSamp, provided-interface=SR_Interface_MCU03_NRF_IdcSamp
