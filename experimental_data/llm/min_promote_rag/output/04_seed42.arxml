AUTOSAR XML (schema 4-2-2)
package /COM_SWC
  application sw component type ASW_COM_MIN
    provide port PPort_MCU01_EmergShutDown: provided-interface=SR_Interface_MCU01_EmergShutDown
