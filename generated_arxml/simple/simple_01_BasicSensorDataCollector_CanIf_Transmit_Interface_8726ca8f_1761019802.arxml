AUTOSAR XML (schema 4-2-2)
package /Interfaces
  client server interface CanIf_Transmit_Interface: is-service=true
    operation Transmit
