AUTOSAR XML (schema 4-2-2)
package /Interfaces
  sender receiver interface Motor_Command_Interface
    data motor1_cmd: type=float32
    data motor2_cmd: type=float32
    data enable: type=boolean
