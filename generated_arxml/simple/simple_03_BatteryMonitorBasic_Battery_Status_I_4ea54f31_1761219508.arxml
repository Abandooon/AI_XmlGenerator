AUTOSAR XML (schema 4-2-2)
package /Interfaces
  sender receiver interface Battery_Status_I
    5 x data:
      voltage_mV: type=uint16
      current_mA: type=sint16
      temp_cDegC: type=sint16
      soc_perc: type=uint8
      status_flags: type=uint8
