AUTOSAR XML (schema 4-2-2)
package /Interfaces
  sender receiver interface Seat_Temp_IF
    4 x data, all with type=float32:
      Seat1_Temp_A
      Seat1_Temp_B
      Seat2_Temp_A
      Seat2_Temp_B
