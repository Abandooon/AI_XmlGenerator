AUTOSAR XML (schema 4-2-2)
package /Interfaces
  sender receiver interface ProcessedData_SR_Interface
    data CalibratedTemp{1..3}: type=float32
