AUTOSAR XML (schema 4-2-2)
package /Interfaces
  sender receiver interface RainSensor_To_WiperController
    data rain_level: type=float32
    data fault_status: type=uint8
