AUTOSAR XML (schema 4-2-2)
package /Interfaces
  sender receiver interface Voltage_Measurement_I
    data voltage_mV: type=uint16
