AUTOSAR XML (schema 4-2-2)
package /Interfaces
  sender receiver interface IF_Lock_Command
    data lock_cmd: type=uint8
