AUTOSAR XML (schema 4-2-2)
package /Interfaces
  sender receiver interface Cmd_In_IF
    4 x data, all with type=float32:
      m1_speed_cmd
      m1_pos_cmd
      m2_speed_cmd
      m2_pos_cmd
