AUTOSAR XML (schema 4-2-2)
package /Interfaces
  sender receiver interface IF_Window_Command
    data window_cmd: type=uint8
