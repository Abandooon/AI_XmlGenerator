AUTOSAR XML (schema 4-2-2)
package /Interfaces
  sender receiver interface IF_Window_Status
    data window_status: type=uint8
