AUTOSAR XML (schema 4-2-2)
package /Interfaces
  sender receiver interface Rain_Level_IF
    data rain_intensity: type=float32
