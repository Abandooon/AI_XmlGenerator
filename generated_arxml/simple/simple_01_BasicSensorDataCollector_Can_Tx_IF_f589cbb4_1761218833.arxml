AUTOSAR XML (schema 4-2-2)
package /Interfaces
  client server interface Can_Tx_IF: is-service=true
    operation Send_Temp_CanFrame
