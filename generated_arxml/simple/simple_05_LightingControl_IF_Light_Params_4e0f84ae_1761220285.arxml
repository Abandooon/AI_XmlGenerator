AUTOSAR XML (schema 4-2-2)
package /Interfaces
  parameter interface IF_Light_Params
    4 x parameter data prototype:
      pwm_max_duty: type=uint8
      pwm_min_duty: type=uint8
      fault_current_threshold: type=uint16
      retry_count: type=uint8
