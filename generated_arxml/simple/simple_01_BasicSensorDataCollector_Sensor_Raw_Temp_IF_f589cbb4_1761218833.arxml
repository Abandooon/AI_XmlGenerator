AUTOSAR XML (schema 4-2-2)
package /Interfaces
  sender receiver interface Sensor_Raw_Temp_IF
    data Temp{1..3}_Raw: type=sint16
