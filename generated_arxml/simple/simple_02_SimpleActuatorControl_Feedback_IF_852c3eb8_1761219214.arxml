AUTOSAR XML (schema 4-2-2)
package /Interfaces
  sender receiver interface Feedback_IF
    4 x data, all with type=float32:
      m1_speed_meas
      m1_pos_meas
      m2_speed_meas
      m2_pos_meas
