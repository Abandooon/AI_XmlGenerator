AUTOSAR XML (schema 4-2-2)
package /Interfaces
  sender receiver interface User_Settings_IF
    data wiper_mode_auto: type=boolean
    data front_manual_speed: type=uint8
    data rear_manual_speed: type=uint8
