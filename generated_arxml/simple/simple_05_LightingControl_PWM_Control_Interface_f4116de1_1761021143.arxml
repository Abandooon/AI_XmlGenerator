AUTOSAR XML (schema 4-2-2)
package /Interfaces
  sender receiver interface PWM_Control_Interface
    data PWM_Channel_Command: type=uint8
    data Brightness_Value: type=uint8
    data Enable_Flag: type=boolean
