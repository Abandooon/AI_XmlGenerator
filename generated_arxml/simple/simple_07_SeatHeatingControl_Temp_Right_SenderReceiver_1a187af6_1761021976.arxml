AUTOSAR XML (schema 4-2-2)
package /Interfaces
  sender receiver interface Temp_Right_SenderReceiver
    data Right_Sensor1_Temperature: type=float32
    data Right_Sensor2_Temperature: type=float32
    data Right_Seat_Fused_Temperature: type=float32
