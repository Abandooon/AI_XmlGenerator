AUTOSAR XML (schema 4-2-2)
package /Interfaces
  client server interface UDS_Service_IF: is-service=true
    operation DiagnosticRequest
    operation DiagnosticResponse
