AUTOSAR XML (schema 4-2-2)
package /Interfaces
  sender receiver interface IF_PWM_Control
    4 x data, all with type=uint8:
      headlamp_duty_setpoint
      tail_lamp_duty_setpoint
      left_turn_duty_setpoint
      right_turn_duty_setpoint
