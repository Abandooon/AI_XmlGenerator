AUTOSAR XML (schema 4-2-2)
package /Interfaces
  sender receiver interface CAN_Command_IF
    5 x data:
      node_id: type=uint8
      door_id: type=uint8
      action: type=ActionEnum
      request_id: type=uint16
      timestamp: type=uint32
