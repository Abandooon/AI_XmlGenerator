AUTOSAR XML (schema 4-2-2)
package /Interfaces
  sender receiver interface Processed_Temp_IF
    data Temp{1..3}_Proc: type=float32
