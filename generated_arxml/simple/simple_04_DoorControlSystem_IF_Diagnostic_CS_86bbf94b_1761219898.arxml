AUTOSAR XML (schema 4-2-2)
package /Interfaces
  client server interface IF_Diagnostic_CS: is-service=true
    operation Read_DID
    operation Clear_DTC
    operation Routine_Control
