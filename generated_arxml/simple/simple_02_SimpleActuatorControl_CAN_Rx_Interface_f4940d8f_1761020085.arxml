AUTOSAR XML (schema 4-2-2)
package /Interfaces
  sender receiver interface CAN_Rx_Interface
    data position: type=float32
    data speed: type=float32
    data control_mode: type=uint8
