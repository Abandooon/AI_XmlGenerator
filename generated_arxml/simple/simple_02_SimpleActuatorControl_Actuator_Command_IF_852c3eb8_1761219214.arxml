AUTOSAR XML (schema 4-2-2)
package /Interfaces
  sender receiver interface Actuator_Command_IF
    data m1_pwm_duty: type=float32
    data m2_pwm_duty: type=float32
