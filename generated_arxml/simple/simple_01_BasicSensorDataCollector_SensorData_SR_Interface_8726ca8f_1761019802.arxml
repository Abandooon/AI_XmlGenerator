AUTOSAR XML (schema 4-2-2)
package /Interfaces
  sender receiver interface SensorData_SR_Interface
    data RawTemp{1..3}: type=float32
