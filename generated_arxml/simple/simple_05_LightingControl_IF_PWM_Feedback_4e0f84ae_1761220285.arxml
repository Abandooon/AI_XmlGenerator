AUTOSAR XML (schema 4-2-2)
package /Interfaces
  sender receiver interface IF_PWM_Feedback
    5 x data:
      headlamp_current_brightness: type=uint8
      tail_lamp_current_brightness: type=uint8
      left_turn_status: type=boolean
      right_turn_status: type=boolean
      lamp_fault_code: type=uint16
