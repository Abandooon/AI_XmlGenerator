AUTOSAR XML (schema 4-2-2)
package /Interfaces
  sender receiver interface IF_Lock_Status
    data lock_status: type=uint8
