AUTOSAR XML (schema 4-2-2)
package /Interfaces
  sender receiver interface Heating_Status_IF
    4 x data:
      Seat1_Actual_Level: type=uint8
      Seat2_Actual_Level: type=uint8
      Seat1_Fault: type=boolean
      Seat2_Fault: type=boolean
