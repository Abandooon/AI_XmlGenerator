AUTOSAR XML (schema 4-2-2)
package /Interfaces
  sender receiver interface IF_Can_Status
    5 x data:
      headlamp_status: type=boolean
      tail_lamp_status: type=boolean
      left_turn_status: type=boolean
      right_turn_status: type=boolean
      fault_code: type=uint16
