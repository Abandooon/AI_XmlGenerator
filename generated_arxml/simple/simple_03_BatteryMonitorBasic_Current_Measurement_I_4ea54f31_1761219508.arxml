AUTOSAR XML (schema 4-2-2)
package /Interfaces
  sender receiver interface Current_Measurement_I
    data current_mA: type=sint16
