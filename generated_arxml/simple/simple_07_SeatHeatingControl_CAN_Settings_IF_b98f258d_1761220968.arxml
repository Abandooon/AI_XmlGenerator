AUTOSAR XML (schema 4-2-2)
package /Interfaces
  sender receiver interface CAN_Settings_IF
    data Seat1_Target_Level: type=uint8
    data Seat2_Target_Level: type=uint8
