AUTOSAR XML (schema 4-2-2)
package /Interfaces
  sender receiver interface Temp_Measurement_I
    data temp_cDegC: type=sint16
