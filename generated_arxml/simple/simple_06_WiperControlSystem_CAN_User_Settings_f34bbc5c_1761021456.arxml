AUTOSAR XML (schema 4-2-2)
package /Interfaces
  sender receiver interface CAN_User_Settings
    data wiper_mode: type=WiperMode
    data speed_level: type=uint8
