AUTOSAR XML (schema 4-2-2)
package /Interfaces
  sender receiver interface Diag_Status_IF
    data diag_status: type=uint32
    data fault_code: type=uint16
