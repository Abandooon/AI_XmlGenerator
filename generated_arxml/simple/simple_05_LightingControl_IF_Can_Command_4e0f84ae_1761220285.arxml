AUTOSAR XML (schema 4-2-2)
package /Interfaces
  sender receiver interface IF_Can_Command
    7 x data:
      headlamp_on_cmd: type=boolean
      tail_lamp_on_cmd: type=boolean
      left_turn_cmd: type=boolean
      right_turn_cmd: type=boolean
      headlamp_brightness_cmd: type=uint8
      tail_brightness_cmd: type=uint8
      turn_brightness_cmd: type=uint8
