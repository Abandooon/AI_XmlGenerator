AUTOSAR XML (schema 4-2-2)
package /Interfaces
  sender receiver interface Wiper_Command_IF
    data front_wiper_cmd: type=uint8
    data rear_wiper_cmd: type=uint8
