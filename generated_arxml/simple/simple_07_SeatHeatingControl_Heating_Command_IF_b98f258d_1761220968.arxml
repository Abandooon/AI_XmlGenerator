AUTOSAR XML (schema 4-2-2)
package /Interfaces
  sender receiver interface Heating_Command_IF
    data Seat1_Command_Level: type=uint8
    data Seat2_Command_Level: type=uint8
