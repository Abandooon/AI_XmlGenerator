AUTOSAR XML (schema 4-2-2)
package /Interfaces
  sender receiver interface Fault_Report_IF
    data fault_id: type=uint16
    data severity: type=uint8
