AUTOSAR XML (schema 4-2-2)
package /Interfaces
  sender receiver interface Control_Command_IF
    data Longitudinal_Command: type=Longitudinal_Command
    data Lateral_Command: type=Lateral_Command
