AUTOSAR XML (schema 4-2-2)
package /Interfaces
  sender receiver interface Safety_Mode_IF
    data safety_mode_state: type=uint8
