AUTOSAR XML (schema 4-2-2)
package /Interfaces
  sender receiver interface Camera_Data_IF
    data Camera_LaneModel: type=Camera_LaneModel
    data Camera_ObjectList: type=Camera_ObjectList
