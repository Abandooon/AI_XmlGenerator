AUTOSAR XML (schema 4-2-2)
package /Interfaces
  client server interface Balancer_Control_Interface: is-service=true
    operation SetBalanceCmd
    operation GetBalanceAck
