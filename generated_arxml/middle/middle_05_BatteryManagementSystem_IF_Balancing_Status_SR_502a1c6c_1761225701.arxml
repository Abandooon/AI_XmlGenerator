AUTOSAR XML (schema 4-2-2)
package /Interfaces
  sender receiver interface IF_Balancing_Status_SR
    data BalancingActive: type=boolean
    data MaxDeltaVoltage: type=float32
    data BalancingFault: type=boolean
