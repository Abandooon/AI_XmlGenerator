AUTOSAR XML (schema 4-2-2)
package /Interfaces
  client server interface Seat_ClientServer_Interface
    operation Seat_SetPosition
    operation Seat_GetPosition
    operation Heater_Control
