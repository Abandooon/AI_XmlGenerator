AUTOSAR XML (schema 4-2-2)
package /Interfaces
  sender receiver interface Transmission_Torque_Capability_IF
    data trans_torque_capability_nm: type=float32
