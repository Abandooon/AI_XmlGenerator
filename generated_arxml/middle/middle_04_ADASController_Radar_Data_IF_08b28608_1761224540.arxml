AUTOSAR XML (schema 4-2-2)
package /Interfaces
  sender receiver interface Radar_Data_IF
    data Radar_PointCloud: type=Radar_PointCloud
    data Radar_Tracks: type=Radar_Tracks
