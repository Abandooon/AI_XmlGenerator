AUTOSAR XML (schema 4-2-2)
package /Interfaces
  sender receiver interface BT_Media_Transport_IF
    data audio_pcm_frame: type=sint16
    data sample_rate_hz: type=uint32
    data channels: type=uint8
