AUTOSAR XML (schema 4-2-2)
package /Interfaces
  parameter interface ESP_Params_IF
    parameter data prototype esp_yaw_gain: type=float32
    parameter data prototype esp_slip_threshold: type=float32
