AUTOSAR XML (schema 4-2-2)
package /Interfaces
  sender receiver interface Bus_Status_SRI
    data bus_online: type=boolean
    data bus_error_count: type=uint16
    data bus_load: type=uint8
