AUTOSAR XML (schema 4-2-2)
package /Interfaces
  client server interface IF_Cooling_Control_CSI: is-service=true
    operation SetCoolantPumpSpeed
    operation SetFanSpeed
    operation SetCoolingMode
