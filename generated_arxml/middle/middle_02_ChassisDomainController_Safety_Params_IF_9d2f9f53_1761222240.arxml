AUTOSAR XML (schema 4-2-2)
package /Interfaces
  parameter interface Safety_Params_IF
    parameter data prototype safety_mode_ruleset: type=uint8
    parameter data prototype fault_escalation_threshold: type=uint8
