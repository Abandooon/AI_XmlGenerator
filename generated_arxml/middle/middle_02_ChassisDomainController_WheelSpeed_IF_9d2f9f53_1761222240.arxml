AUTOSAR XML (schema 4-2-2)
package /Interfaces
  sender receiver interface WheelSpeed_IF
    4 x data, all with type=float32:
      wheel_speed_fl
      wheel_speed_fr
      wheel_speed_rl
      wheel_speed_rr
