AUTOSAR XML (schema 4-2-2)
package /Interfaces
  sender receiver interface IF_SOC_SOH_SR
    data PackSOC: type=uint8
    data PackSOH: type=uint8
