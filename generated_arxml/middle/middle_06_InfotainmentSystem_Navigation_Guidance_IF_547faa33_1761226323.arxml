AUTOSAR XML (schema 4-2-2)
package /Interfaces
  sender receiver interface Navigation_Guidance_IF
    data turn_type: type=uint8
    data distance_to_turn_m: type=uint16
    data lane_recommendation: type=uint8
