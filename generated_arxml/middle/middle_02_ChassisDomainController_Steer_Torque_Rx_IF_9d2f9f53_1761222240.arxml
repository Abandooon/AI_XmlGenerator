AUTOSAR XML (schema 4-2-2)
package /Interfaces
  sender receiver interface Steer_Torque_Rx_IF
    data steer_torque: type=float32
