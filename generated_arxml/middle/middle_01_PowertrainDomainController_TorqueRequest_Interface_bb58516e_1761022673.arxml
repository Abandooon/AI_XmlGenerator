AUTOSAR XML (schema 4-2-2)
package /Interfaces
  sender receiver interface TorqueRequest_Interface
    5 x data:
      TorqueRequest_torque: type=float32
      TorqueRequest_source: type=uint8
      TorqueRequest_timestamp: type=uint32
      TorqueAck_status: type=uint8
      TorqueAck_timestamp: type=uint32
