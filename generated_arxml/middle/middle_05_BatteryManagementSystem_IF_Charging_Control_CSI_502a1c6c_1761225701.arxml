AUTOSAR XML (schema 4-2-2)
package /Interfaces
  client server interface IF_Charging_Control_CSI: is-service=true
    operation RequestChargeMode
    operation SetChargeCurrentLimit
    operation StopCharging
