AUTOSAR XML (schema 4-2-2)
package /Interfaces
  sender receiver interface Engine_Torque_Capability_IF
    data engine_torque_capability_nm: type=float32
