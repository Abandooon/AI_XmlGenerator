AUTOSAR XML (schema 4-2-2)
package /Interfaces
  sender receiver interface Regen_Torque_Capability_IF
    data regen_torque_capability_nm: type=float32
