AUTOSAR XML (schema 4-2-2)
package /Interfaces
  client server interface Navigation_Control_IF: is-service=true
    operation StartRoute
    operation CancelRoute
    operation SetDestination
