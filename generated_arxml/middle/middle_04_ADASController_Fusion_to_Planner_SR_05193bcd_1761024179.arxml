AUTOSAR XML (schema 4-2-2)
package /Interfaces
  sender receiver interface Fusion_to_Planner_SR
    data FusedObjectList: type=FusedObjectList
    data Timestamp: type=uint64
    data ConfidenceMetrics: type=ConfidenceMetrics
