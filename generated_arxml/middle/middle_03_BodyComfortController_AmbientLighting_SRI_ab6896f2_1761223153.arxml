AUTOSAR XML (schema 4-2-2)
package /Interfaces
  sender receiver interface AmbientLighting_SRI
    data ambient_color_cmd: type=uint32
    data ambient_brightness_cmd: type=uint8
    data ambient_status: type=uint8
