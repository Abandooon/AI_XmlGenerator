AUTOSAR XML (schema 4-2-2)
package /Interfaces
  trigger interface Safety_Events_Interface
    trigger SafetyEventTriggered
