AUTOSAR XML (schema 4-2-2)
package /Interfaces
  sender receiver interface IF_Charge_Status_SR
    data ChargeMode: type=uint8
    data ChargeCurrentSetpoint: type=float32
    data ChargeFault: type=boolean
