AUTOSAR XML (schema 4-2-2)
package /Interfaces
  sender receiver interface IF_Temp_Data
    12 x data, all with type=float32:
      t_motor
      t_inverter
      t_battery_pack
      t_batt_coolant_in
      t_batt_coolant_out
      t_cabin_ambient
      t_evap_outlet
      t_heater_core
      t_radiator_outlet
      t_pump{1..3}_housing
