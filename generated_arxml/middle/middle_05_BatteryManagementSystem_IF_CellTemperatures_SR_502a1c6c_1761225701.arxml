AUTOSAR XML (schema 4-2-2)
package /Interfaces
  sender receiver interface IF_CellTemperatures_SR
    data CellTemperatures_Array: type=float32
    data PackTemperature: type=float32
