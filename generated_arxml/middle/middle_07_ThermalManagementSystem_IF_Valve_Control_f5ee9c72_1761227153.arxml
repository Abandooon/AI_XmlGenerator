AUTOSAR XML (schema 4-2-2)
package /Interfaces
  client server interface IF_Valve_Control: is-service=true
    operation op_set_valve_position
    operation op_get_valve_status
