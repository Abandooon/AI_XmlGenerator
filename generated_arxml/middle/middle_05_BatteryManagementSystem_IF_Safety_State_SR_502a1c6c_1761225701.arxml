AUTOSAR XML (schema 4-2-2)
package /Interfaces
  sender receiver interface IF_Safety_State_SR
    data SafetyState: type=uint8
    data FaultCode: type=uint32
