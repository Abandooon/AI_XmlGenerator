AUTOSAR XML (schema 4-2-2)
package /Interfaces
  sender receiver interface IF_BMS_Status_To_VCU_SR
    data BMS_Status_Frame: type=uint64
    data BMS_Diagnostics_Frame: type=uint64
