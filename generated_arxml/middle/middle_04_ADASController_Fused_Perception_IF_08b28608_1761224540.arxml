AUTOSAR XML (schema 4-2-2)
package /Interfaces
  sender receiver interface Fused_Perception_IF
    data Fused_ObjectList: type=Fused_ObjectList
    data Ego_State: type=Ego_State
