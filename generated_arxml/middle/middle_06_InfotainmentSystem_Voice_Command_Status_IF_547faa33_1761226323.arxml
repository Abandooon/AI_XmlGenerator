AUTOSAR XML (schema 4-2-2)
package /Interfaces
  sender receiver interface Voice_Command_Status_IF
    data command_result: type=uint8
    data confidence: type=float32
