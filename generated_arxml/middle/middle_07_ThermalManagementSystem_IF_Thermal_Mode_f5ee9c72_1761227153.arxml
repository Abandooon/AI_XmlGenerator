AUTOSAR XML (schema 4-2-2)
package /Interfaces
  mode switch interface IF_Thermal_Mode
    mode group ThermalModeGroup: type=ThermalModeGroup
