AUTOSAR XML (schema 4-2-2)
package /Interfaces
  sender receiver interface YawRate_IF
    data yaw_rate: type=float32
