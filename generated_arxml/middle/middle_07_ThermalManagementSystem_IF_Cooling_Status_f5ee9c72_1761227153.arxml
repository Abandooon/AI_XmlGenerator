AUTOSAR XML (schema 4-2-2)
package /Interfaces
  sender receiver interface IF_Cooling_Status
    data motor_cooling_status: type=uint32
    data battery_cooling_status: type=uint32
    data cabin_cooling_status: type=uint32
