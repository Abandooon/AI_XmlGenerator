AUTOSAR XML (schema 4-2-2)
package /Interfaces
  sender receiver interface ABS_Status_IF
    data abs_active: type=boolean
    data abs_fault_code: type=uint16
