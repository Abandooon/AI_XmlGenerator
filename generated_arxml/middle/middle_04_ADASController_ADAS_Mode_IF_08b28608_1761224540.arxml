AUTOSAR XML (schema 4-2-2)
package /Interfaces
  mode switch interface ADAS_Mode_IF
    mode group ADAS_ModeGroup: type=ADAS_ModeGroup
