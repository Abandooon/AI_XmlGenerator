AUTOSAR XML (schema 4-2-2)
package /Interfaces
  sender receiver interface PowertrainCAN_Interface
    data CAN_Frame_id: type=uint32
    data CAN_Frame_data: type=uint8
    data CAN_Frame_timestamp: type=uint32
