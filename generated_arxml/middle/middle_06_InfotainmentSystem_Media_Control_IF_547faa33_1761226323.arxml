AUTOSAR XML (schema 4-2-2)
package /Interfaces
  client server interface Media_Control_IF: is-service=true
    6 x operation:
      Play
      Pause
      Stop
      NextTrack
      PreviousTrack
      SetSource
