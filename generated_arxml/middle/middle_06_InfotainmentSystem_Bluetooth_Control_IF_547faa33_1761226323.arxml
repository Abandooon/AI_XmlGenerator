AUTOSAR XML (schema 4-2-2)
package /Interfaces
  client server interface Bluetooth_Control_IF: is-service=true
    6 x operation:
      Pair
      ConnectAudio
      ConnectPhone
      DialNumber
      AnswerCall
      Hangup
