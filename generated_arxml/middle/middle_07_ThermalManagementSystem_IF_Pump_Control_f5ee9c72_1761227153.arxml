AUTOSAR XML (schema 4-2-2)
package /Interfaces
  client server interface IF_Pump_Control: is-service=true
    4 x operation:
      op_set_pump_speed
      op_start_pump
      op_stop_pump
      op_get_pump_status
