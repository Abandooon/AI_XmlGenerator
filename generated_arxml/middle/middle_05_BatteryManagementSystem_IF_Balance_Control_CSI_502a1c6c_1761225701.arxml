AUTOSAR XML (schema 4-2-2)
package /Interfaces
  client server interface IF_Balance_Control_CSI: is-service=true
    operation EnableBalancing
    operation SuspendBalancing
    operation SetBalanceTargets
