AUTOSAR XML (schema 4-2-2)
package /Interfaces
  sender receiver interface CAN_Wheel_Speed_Rx_IF
    4 x data, all with type=float32:
      raw_wheel_speed_fl
      raw_wheel_speed_fr
      raw_wheel_speed_rl
      raw_wheel_speed_rr
