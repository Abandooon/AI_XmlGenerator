AUTOSAR XML (schema 4-2-2)
package /Interfaces
  client server interface CAN_Routing_IF: is-service=true
    operation SendABSCommand
    operation SendEPSCommand
    operation SendESPCommand
