AUTOSAR XML (schema 4-2-2)
package /Interfaces
  parameter interface ABS_Params_IF
    parameter data prototype abs_slip_threshold: type=float32
    parameter data prototype abs_gain: type=float32
