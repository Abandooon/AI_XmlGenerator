AUTOSAR XML (schema 4-2-2)
package /Interfaces
  sender receiver interface Seat_Control_SRI
    4 x data, all with type=uint8:
      seat_position_cmd
      seat_heater_cmd
      seat_position_feedback
      seat_heater_status
