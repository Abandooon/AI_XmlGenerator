AUTOSAR XML (schema 4-2-2)
package /Interfaces
  sender receiver interface Torque_Command_IF
    data engine_torque_cmd_nm: type=float32
    data trans_torque_cmd_nm: type=float32
    data regen_torque_cmd_nm: type=float32
