AUTOSAR XML (schema 4-2-2)
package /Interfaces
  sender receiver interface IF_Thermal_Setpoint
    data target_motor_coolant_flow: type=float32
    data target_battery_coolant_flow: type=float32
    data target_cabin_evap_duty: type=float32
