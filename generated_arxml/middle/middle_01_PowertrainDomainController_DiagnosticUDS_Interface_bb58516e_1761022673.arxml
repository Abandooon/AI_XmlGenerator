AUTOSAR XML (schema 4-2-2)
package /Interfaces
  client server interface DiagnosticUDS_Interface: is-service=true
    operation ReadDataByIdentifier
    operation ClearDTC
