AUTOSAR XML (schema 4-2-2)
package /Interfaces
  parameter interface WSP_Params_IF
    parameter data prototype wsp_filter_time_constant: type=float32
    parameter data prototype wsp_quality_threshold: type=float32
