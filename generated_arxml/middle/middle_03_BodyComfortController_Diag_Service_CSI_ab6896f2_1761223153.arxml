AUTOSAR XML (schema 4-2-2)
package /Interfaces
  client server interface Diag_Service_CSI: is-service=true
    4 x operation:
      StartOTAUpdate
      GetUpdateStatus
      ReadDTC
      ClearDTC
