AUTOSAR XML (schema 4-2-2)
package /Interfaces
  client server interface Parameter_Service_CS: is-service=true
    operation GetSetParameter
