AUTOSAR XML (schema 4-2-2)
package /Interfaces
  sender receiver interface ESP_Status_IF
    data esp_active: type=boolean
    data esp_fault_code: type=uint16
