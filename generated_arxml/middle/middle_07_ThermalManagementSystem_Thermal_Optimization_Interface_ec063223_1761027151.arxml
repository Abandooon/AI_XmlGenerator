AUTOSAR XML (schema 4-2-2)
package /Interfaces
  client server interface Thermal_Optimization_Interface: is-service=true
    operation SubmitOptimizationPlan
    operation GetOptimizationAck
