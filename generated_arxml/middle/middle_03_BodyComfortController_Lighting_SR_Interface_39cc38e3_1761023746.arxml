AUTOSAR XML (schema 4-2-2)
package /Interfaces
  sender receiver interface Lighting_SR_Interface
    data Lighting_Frame: type=uint8
    data Lighting_Status: type=uint8
