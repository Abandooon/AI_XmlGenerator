AUTOSAR XML (schema 4-2-2)
package /Interfaces
  sender receiver interface IF_Thermal_Status_SR
    data CoolantPumpSpeed: type=uint16
    data FanSpeed: type=uint16
    data ThermalFault: type=boolean
