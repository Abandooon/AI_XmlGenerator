AUTOSAR XML (schema 4-2-2)
package /Interfaces
  sender receiver interface Camera_to_Fusion_SR
    data DetectionList: type=DetectionList
    data ImageFeatures: type=ImageFeatures
    data Timestamp: type=uint64
