AUTOSAR XML (schema 4-2-2)
package /Interfaces
  sender receiver interface DoorWindow_Control_SRI
    4 x data:
      door_lock_cmd: type=boolean
      window_move_cmd: type=uint8
      door_status: type=uint8
      window_position: type=uint8
