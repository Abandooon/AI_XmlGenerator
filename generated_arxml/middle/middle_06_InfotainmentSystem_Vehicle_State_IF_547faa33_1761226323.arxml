AUTOSAR XML (schema 4-2-2)
package /Interfaces
  sender receiver interface Vehicle_State_IF
    data vehicle_speed_kph: type=uint16
    data vehicle_gear: type=uint8
