AUTOSAR XML (schema 4-2-2)
package /Interfaces
  client server interface ShiftRequest_Interface: is-service=true
    operation RequestShift
