AUTOSAR XML (schema 4-2-2)
package /Interfaces
  sender receiver interface Climate_Control_SRI
    5 x data:
      hvac_target_temp: type=float32
      fan_speed_cmd: type=uint8
      ac_on_cmd: type=boolean
      cabin_temp_feedback: type=float32
      ac_status: type=uint8
