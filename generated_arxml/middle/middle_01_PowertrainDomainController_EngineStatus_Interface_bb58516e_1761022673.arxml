AUTOSAR XML (schema 4-2-2)
package /Interfaces
  sender receiver interface EngineStatus_Interface
    data EngineRPM: type=uint16
    data EngineTorqueAvailable: type=float32
    data EngineFaultFlags: type=uint32
