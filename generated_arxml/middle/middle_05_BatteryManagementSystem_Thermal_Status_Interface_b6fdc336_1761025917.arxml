AUTOSAR XML (schema 4-2-2)
package /Interfaces
  sender receiver interface Thermal_Status_Interface
    data temperatures: type=TemperatureArray
    data coolant_flow: type=float32
    data thermal_status: type=uint8
