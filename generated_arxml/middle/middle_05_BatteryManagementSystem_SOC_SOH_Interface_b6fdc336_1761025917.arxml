AUTOSAR XML (schema 4-2-2)
package /Interfaces
  sender receiver interface SOC_SOH_Interface
    data SOC: type=float32
    data SOH: type=float32
    data state_flags: type=uint8
