AUTOSAR XML (schema 4-2-2)
package /Interfaces
  sender receiver interface Climate_SR_Interface
    data CabinTemp: type=float32
    data HVAC_Command: type=uint8
