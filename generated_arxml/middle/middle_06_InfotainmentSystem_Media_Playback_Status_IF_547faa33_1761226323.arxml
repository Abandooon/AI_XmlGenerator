AUTOSAR XML (schema 4-2-2)
package /Interfaces
  sender receiver interface Media_Playback_Status_IF
    data play_state: type=uint8
    data track_title: type=uint32
    data elapsed_ms: type=uint32
