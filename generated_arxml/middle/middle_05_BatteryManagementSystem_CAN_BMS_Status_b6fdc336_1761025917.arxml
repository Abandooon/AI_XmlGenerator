AUTOSAR XML (schema 4-2-2)
package /Interfaces
  sender receiver interface CAN_BMS_Status
    data bms_summary: type=BMS_SummaryType
    data fault_codes: type=uint32
