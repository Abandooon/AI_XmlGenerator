AUTOSAR XML (schema 4-2-2)
package /Interfaces
  client server interface OTA_ClientServer_Interface: is-service=true
    operation FW_Segment
    operation FW_Update_Control
