AUTOSAR XML (schema 4-2-2)
package /Interfaces
  client server interface SteeringMotor_Service: is-service=true
    operation SteeringCommand
    operation SteeringAck
    operation SteeringDiagnostic
