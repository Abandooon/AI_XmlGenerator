AUTOSAR XML (schema 4-2-2)
package /Interfaces
  sender receiver interface EPS_Status_IF
    data eps_active: type=boolean
    data eps_fault_code: type=uint16
