AUTOSAR XML (schema 4-2-2)
package /Interfaces
  sender receiver interface Torque_Request_IF
    data driver_torque_request_nm: type=float32
