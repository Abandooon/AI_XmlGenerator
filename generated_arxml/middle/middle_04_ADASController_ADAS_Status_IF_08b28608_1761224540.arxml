AUTOSAR XML (schema 4-2-2)
package /Interfaces
  sender receiver interface ADAS_Status_IF
    data ACC_Status: type=ACC_Status
    data LKA_Status: type=LKA_Status
    data AEB_Status: type=AEB_Status
