AUTOSAR XML (schema 4-2-2)
package /Interfaces
  parameter interface EPS_Params_IF
    parameter data prototype eps_assist_gain: type=float32
    parameter data prototype eps_limit: type=float32
