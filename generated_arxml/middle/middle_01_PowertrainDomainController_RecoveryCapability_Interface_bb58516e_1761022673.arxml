AUTOSAR XML (schema 4-2-2)
package /Interfaces
  sender receiver interface RecoveryCapability_Interface
    data RecoveryTorqueCapability: type=float32
    data RecoveryMaxDuration: type=uint32
    data RecoveryStatus: type=uint8
