AUTOSAR XML (schema 4-2-2)
package /Interfaces
  sender receiver interface Phone_Status_IF
    data call_state: type=uint8
    data caller_id: type=uint64
