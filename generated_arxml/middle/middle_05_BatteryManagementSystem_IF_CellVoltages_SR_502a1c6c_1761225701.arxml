AUTOSAR XML (schema 4-2-2)
package /Interfaces
  sender receiver interface IF_CellVoltages_SR
    data CellVoltages_Array: type=float32
    data PackVoltage: type=float32
