AUTOSAR XML (schema 4-2-2)
package /Interfaces
  sender receiver interface IF_CD_Frame_SR
    data CD_Frame: type=uint32
    data Layer_Composition: type=uint32
    data Timestamp: type=uint64
