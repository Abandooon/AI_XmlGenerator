AUTOSAR XML (schema 4-2-2)
package /Interfaces
  sender receiver interface IF_Ethernet_Frame_SR
    data ethernet_frame: type=uint8
    data vlan_tag: type=uint16
    data link_status: type=boolean
