AUTOSAR XML (schema 4-2-2)
package /Interfaces
  sender receiver interface IF_Perception_To_Prediction
    data Tracked_Objects: type=uint8
