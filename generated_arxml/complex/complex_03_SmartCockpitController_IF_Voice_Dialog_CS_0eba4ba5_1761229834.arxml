AUTOSAR XML (schema 4-2-2)
package /Interfaces
  client server interface IF_Voice_Dialog_CS: is-service=true
    operation Start_Session
    operation Process_Utterance
    operation Get_Response
