AUTOSAR XML (schema 4-2-2)
package /Interfaces
  client server interface IF_Display_Control_CS: is-service=true
    operation Set_Brightness
    operation Set_Mode
    operation Show_Alert
