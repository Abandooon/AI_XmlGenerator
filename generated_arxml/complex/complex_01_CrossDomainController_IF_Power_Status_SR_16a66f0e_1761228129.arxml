AUTOSAR XML (schema 4-2-2)
package /Interfaces
  sender receiver interface IF_Power_Status_SR
    4 x data:
      soc: type=uint8
      power_available: type=float32
      regen_limit: type=float32
      thermal_derate: type=uint8
