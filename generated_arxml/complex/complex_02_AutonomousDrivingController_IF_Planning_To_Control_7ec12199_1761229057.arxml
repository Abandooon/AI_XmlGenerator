AUTOSAR XML (schema 4-2-2)
package /Interfaces
  sender receiver interface IF_Planning_To_Control
    data Target_Trajectory: type=float32
    data Speed_Profile: type=float32
    data Behavior_Cmd: type=uint16
