AUTOSAR XML (schema 4-2-2)
package /Interfaces
  nv data interface IF_OTA_NV
    nv-datas:
      4 x data:
        ota_metadata_block: type=uint8
        partition_map: type=uint32
        image_hash: type=uint8
        install_status: type=uint8
