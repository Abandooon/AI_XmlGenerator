AUTOSAR XML (schema 4-2-2)
package /Interfaces
  sender receiver interface IF_Sensor_Hub_To_Sensor_Fusion
    6 x data:
      Camera_Frames: type=uint8
      Radar_Detections: type=float32
      Ultrasonic_Detections: type=float32
      Lidar_PointCloud: type=float32
      IMU_Data: type=float32
      GNSS_Fix: type=float64
