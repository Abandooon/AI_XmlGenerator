AUTOSAR XML (schema 4-2-2)
package /Interfaces
  sender receiver interface IF_IC_Frame_SR
    data IC_Frame: type=uint32
    data Theme_Id: type=uint8
    data Timestamp: type=uint64
