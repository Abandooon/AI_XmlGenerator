AUTOSAR XML (schema 4-2-2)
package /Interfaces
  client server interface IF_SecOC_CS: is-service=true
    operation Generate_Auth_Tag_Op
    operation Verify_Auth_Tag_Op
    operation Rotate_Key_Op
