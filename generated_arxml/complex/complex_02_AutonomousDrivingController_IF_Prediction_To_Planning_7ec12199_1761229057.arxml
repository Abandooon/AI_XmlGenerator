AUTOSAR XML (schema 4-2-2)
package /Interfaces
  sender receiver interface IF_Prediction_To_Planning
    data Predicted_Trajectories: type=float32
