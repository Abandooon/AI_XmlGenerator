AUTOSAR XML (schema 4-2-2)
package /Interfaces
  sender receiver interface IF_CAN_Frame_SR
    data can_frame: type=uint8
    data can_bus_status: type=uint8
