AUTOSAR XML (schema 4-2-2)
package /Interfaces
  sender receiver interface IF_DMS_State_SR
    4 x data:
      Driver_Attention: type=boolean
      Drowsiness_Level: type=uint8
      Eyes_Off_Road: type=boolean
      Timestamp: type=uint64
