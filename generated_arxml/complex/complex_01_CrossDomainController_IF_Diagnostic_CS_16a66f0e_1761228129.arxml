AUTOSAR XML (schema 4-2-2)
package /Interfaces
  client server interface IF_Diagnostic_CS: is-service=true
    4 x operation:
      Diag_Request_Op
      Diag_Response_Op
      ReadDataByIdentifier_Op
      RoutineControl_Op
