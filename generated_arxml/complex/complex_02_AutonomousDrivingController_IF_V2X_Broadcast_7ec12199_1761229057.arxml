AUTOSAR XML (schema 4-2-2)
package /Interfaces
  sender receiver interface IF_V2X_Broadcast
    4 x data, all with type=uint8:
      BSM
      SPaT
      MAP
      RSI
