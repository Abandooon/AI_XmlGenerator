AUTOSAR XML (schema 4-2-2)
package /Interfaces
  sender receiver interface IF_Localization_Broadcast
    data Ego_Pose: type=float64
    data Ego_Velocity: type=float32
    data Localization_Status: type=uint8
