AUTOSAR XML (schema 4-2-2)
package /Interfaces
  client server interface IF_Map_Manager_Service: is-service=true
    operation GetHDMapTile
    operation GetLaneAttributes
    operation GetRoutingGraph
