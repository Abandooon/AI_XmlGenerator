AUTOSAR XML (schema 4-2-2)
package /Interfaces
  sender receiver interface IF_Chassis_Commands_SR
    4 x data:
      torque_request: type=float32
      brake_pressure_cmd: type=float32
      steering_cmd: type=float32
      suspension_mode: type=uint8
