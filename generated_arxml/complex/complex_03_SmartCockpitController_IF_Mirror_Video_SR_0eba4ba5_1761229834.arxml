AUTOSAR XML (schema 4-2-2)
package /Interfaces
  sender receiver interface IF_Mirror_Video_SR
    data Mirror_Frame: type=uint32
    data Channel_Id: type=uint8
    data Timestamp: type=uint64
