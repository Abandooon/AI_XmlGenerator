AUTOSAR XML (schema 4-2-2)
package /Interfaces
  client server interface IF_OTA_CS: is-service=true
    4 x operation:
      Check_Update_Op
      Download_Partition_Op
      Verify_Partition_Op
      Install_Partition_Op
