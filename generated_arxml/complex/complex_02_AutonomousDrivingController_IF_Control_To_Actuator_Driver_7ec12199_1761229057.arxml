AUTOSAR XML (schema 4-2-2)
package /Interfaces
  sender receiver interface IF_Control_To_Actuator_Driver
    data Steering_Angle: type=float32
    data Throttle_Command: type=float32
    data Brake_Command: type=float32
