AUTOSAR XML (schema 4-2-2)
package /Interfaces
  sender receiver interface IF_Failsafe_Commands
    data MRC_Command: type=uint8
    data SOS_Command: type=uint8
    data Failsafe_Status: type=uint8
