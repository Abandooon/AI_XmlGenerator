AUTOSAR XML (schema 4-2-2)
package /Interfaces
  sender receiver interface IF_Body_Comfort_SR
    data hvac_setpoint: type=float32
    data seat_heater_level: type=uint8
    data ambient_light_level: type=uint8
