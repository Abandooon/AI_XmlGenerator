AUTOSAR XML (schema 4-2-2)
package /Interfaces
  sender receiver interface IF_Map_Update_Broadcast
    data Map_Tile_Update: type=uint8
    data Map_Version: type=uint32
