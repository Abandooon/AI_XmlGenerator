AUTOSAR XML (schema 4-2-2)
package /Interfaces
  sender receiver interface IF_Health_Status_SR
    4 x data:
      ecu_health: type=uint8
      temperature: type=float32
      voltage: type=float32
      fault_code: type=uint32
