AUTOSAR XML (schema 4-2-2)
package /Interfaces
  sender receiver interface IF_Sensor_Fusion_To_Perception
    data Fused_Object_List: type=uint8
    data Occupancy_Grid: type=uint8
