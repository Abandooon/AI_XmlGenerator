AUTOSAR XML (schema 4-2-2)
package /Interfaces
  parameter interface IF_Config_Params_PI
    4 x parameter data prototype:
      controller_gains: type=float32
      limits: type=float32
      security_policy: type=uint32
      key_ref: type=uint32
