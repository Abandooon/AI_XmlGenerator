AUTOSAR XML (schema 4-2-2)
package /Interfaces
  sender receiver interface IF_HUD_AR_SR
    data HUD_Frame: type=uint32
    data AR_Nav_Overlay: type=uint32
    data Timestamp: type=uint64
