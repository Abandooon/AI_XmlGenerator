AUTOSAR XML (schema 4-2-2)
package /Interfaces
  sender receiver interface IF_Gesture_Events_SR
    data Gesture_Type: type=uint8
    data Gesture_Confidence: type=float32
    data Timestamp: type=uint64
