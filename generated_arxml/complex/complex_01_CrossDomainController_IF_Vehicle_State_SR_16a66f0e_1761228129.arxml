AUTOSAR XML (schema 4-2-2)
package /Interfaces
  sender receiver interface IF_Vehicle_State_SR
    4 x data, all with type=float32:
      vehicle_speed
      yaw_rate
      longitudinal_accel
      steering_angle
