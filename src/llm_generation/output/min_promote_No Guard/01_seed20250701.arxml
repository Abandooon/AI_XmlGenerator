AUTOSAR XML (schema 4-2-2)
package /ASW_COM_MIN_Package
  application sw component type ASW_COM_MIN
    provide port MCU01_EmergShutDown: nonqueued-sender-com-spec{data-element=MCU01_EmergShutDown, init-value=0}, provided-interface=SR_Interface_MCU01_EmergShutDown
