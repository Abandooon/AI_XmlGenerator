AUTOSAR XML (schema 4-2-2)
package /ASW_COM_MIN_Package
  application sw component type ASW_COM_MIN
    provide port PPort_MCU02_MaxTor: nonqueued-sender-com-spec{data-element=MCU02_MaxTor, init-value=0}, provided-interface=SR_Interface_MCU02_MaxTor
