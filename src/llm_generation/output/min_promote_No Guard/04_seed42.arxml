AUTOSAR XML (schema 4-2-2)
standard types defined: boolean
package /ASW_Components
  application sw component type ASW_COM_MIN
    provide port PPort_MCU01_EmergShutDown: nonqueued-sender-com-spec{data-element=MCU01_EmergShutDown, init-value=0}, provided-interface=SR_Interface_MCU01_EmergShutDown
package /COM_Interface
  sender receiver interface SR_Interface_MCU01_EmergShutDown
    data MCU01_EmergShutDown: type=boolean
  sender receiver interface SR_Interface_MCU02_MaxTor
  sender receiver interface SR_Interface_MCU03_NRF_IdcSamp
