AUTOSAR XML (schema 4-2-2)
package /Interfaces
  client server interface Diagnostic_Service: is-service=true
    operation get_status
    operation clear_fault
