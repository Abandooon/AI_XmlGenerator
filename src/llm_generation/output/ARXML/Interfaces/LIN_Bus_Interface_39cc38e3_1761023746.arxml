AUTOSAR XML (schema 4-2-2)
package /Interfaces
  sender receiver interface LIN_Bus_Interface
    data LIN_Slave_Frame: type=uint8
    data SeatSensor_Frame: type=uint8
