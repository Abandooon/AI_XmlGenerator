AUTOSAR XML (schema 4-2-2)
package /Interfaces
  sender receiver interface IF_VehicleData
    4 x data:
      vehicleSpeed: type=sint32
      gear: type=sint8
      odometer: type=uint32
      brakeStatus: type=boolean
