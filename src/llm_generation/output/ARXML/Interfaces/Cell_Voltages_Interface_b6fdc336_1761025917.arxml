AUTOSAR XML (schema 4-2-2)
package /Interfaces
  sender receiver interface Cell_Voltages_Interface
    data cell_voltage_array: type=CellVoltageArray96
    data cell_status: type=uint8
