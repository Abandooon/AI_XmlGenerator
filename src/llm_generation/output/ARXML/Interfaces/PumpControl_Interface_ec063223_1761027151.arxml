AUTOSAR XML (schema 4-2-2)
package /Interfaces
  client server interface PumpControl_Interface: is-service=true
    operation SetPumpCommand
    operation GetPumpStatus
