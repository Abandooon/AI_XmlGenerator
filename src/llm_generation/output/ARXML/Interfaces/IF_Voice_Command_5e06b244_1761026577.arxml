AUTOSAR XML (schema 4-2-2)
package /Interfaces
  sender receiver interface IF_Voice_Command
    data command: type=String
    data confidence: type=float32
    data sessionId: type=String
