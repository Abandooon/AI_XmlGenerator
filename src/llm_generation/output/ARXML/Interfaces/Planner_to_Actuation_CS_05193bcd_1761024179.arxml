AUTOSAR XML (schema 4-2-2)
package /Interfaces
  client server interface Planner_to_Actuation_CS: is-service=true
    operation SendControlCommand
