AUTOSAR XML (schema 4-2-2)
package /Interfaces
  client server interface IF_Bluetooth_Audio: is-service=true
    operation Control
    operation StreamAudio
