AUTOSAR XML (schema 4-2-2)
package /Interfaces
  mode switch interface ADAS_Mode_Switch: is-service=true
    mode group ADASModeGroup: type=ADASModeGroup
