AUTOSAR XML (schema 4-2-2)
package /Interfaces
  sender receiver interface Actuation_Command_Interface
    data Actuation_Command: type=Actuation_Command
