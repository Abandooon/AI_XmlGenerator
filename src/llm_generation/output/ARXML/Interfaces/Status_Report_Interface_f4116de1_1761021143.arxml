AUTOSAR XML (schema 4-2-2)
package /Interfaces
  sender receiver interface Status_Report_Interface
    4 x data:
      Driver_Fault_Flag: type=boolean
      Overcurrent_Status: type=uint8
      Channel_Temperature: type=float32
      Lamp_Status: type=uint8
