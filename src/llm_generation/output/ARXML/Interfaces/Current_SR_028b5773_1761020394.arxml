AUTOSAR XML (schema 4-2-2)
package /Interfaces
  sender receiver interface Current_SR
    data Current_Amp: type=float32
    data Overcurrent_Flag: type=uint8
