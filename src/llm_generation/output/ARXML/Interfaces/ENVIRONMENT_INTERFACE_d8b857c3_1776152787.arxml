AUTOSAR XML (schema 4-2-2)
package /Interfaces
  nv data interface ENVIRONMENT_INTERFACE: is-service=true
    nv-datas:
      data ENVIRONMENT_DATA: type=ENVIRONMENT_DATA_TYPE
