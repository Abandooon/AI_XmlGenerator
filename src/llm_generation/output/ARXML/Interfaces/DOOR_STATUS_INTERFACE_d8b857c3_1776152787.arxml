AUTOSAR XML (schema 4-2-2)
package /Interfaces
  client server interface DOOR_STATUS_INTERFACE: is-service=true
    operation READ_DOOR_STATUS
