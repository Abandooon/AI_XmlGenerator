AUTOSAR XML (schema 4-2-2)
package /Interfaces
  client server interface Charge_Control_Interface: is-service=true
    operation RequestCharge
    operation GetChargeStatus
