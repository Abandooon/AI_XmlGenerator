AUTOSAR XML (schema 4-2-2)
package /Interfaces
  sender receiver interface CanBus_WheelSpeed
    5 x data:
      WheelSpeed_FL: type=float32
      WheelSpeed_FR: type=float32
      WheelSpeed_RL: type=float32
      WheelSpeed_RR: type=float32
      WheelSpeed_Health: type=boolean
