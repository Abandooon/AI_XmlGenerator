AUTOSAR XML (schema 4-2-2)
package /Interfaces
  sender receiver interface CAN_RX_Interface
    4 x data:
      Headlight_Command: type=boolean
      TailLight_Command: type=boolean
      TurnSignal_Command: type=uint8
      Brightness_Command: type=uint8
