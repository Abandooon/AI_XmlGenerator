AUTOSAR XML (schema 4-2-2)
package /Interfaces
  sender receiver interface Voltage_SR
    data Voltage_Volt: type=float32
