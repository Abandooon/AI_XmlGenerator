AUTOSAR XML (schema 4-2-2)
package /Interfaces
  sender receiver interface Camera_Data_Interface
    data Camera_Image: type=Camera_Image
