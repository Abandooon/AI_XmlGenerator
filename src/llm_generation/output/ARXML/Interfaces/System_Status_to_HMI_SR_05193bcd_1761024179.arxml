AUTOSAR XML (schema 4-2-2)
package /Interfaces
  sender receiver interface System_Status_to_HMI_SR
    data ADAS_Status: type=ADAS_Status
    data Alerts: type=AlertList
    data Timestamp: type=uint64
