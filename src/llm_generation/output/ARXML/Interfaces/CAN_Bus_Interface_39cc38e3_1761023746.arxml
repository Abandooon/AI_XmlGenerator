AUTOSAR XML (schema 4-2-2)
package /Interfaces
  sender receiver interface CAN_Bus_Interface
    5 x data, all with type=uint8:
      DoorCmd_Frame
      SeatCmd_Frame
      ClimateCmd_Frame
      Lighting_Frame
      Diag_Frame
