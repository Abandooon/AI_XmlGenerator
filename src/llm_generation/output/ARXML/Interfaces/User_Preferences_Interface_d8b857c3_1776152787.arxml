AUTOSAR XML (schema 4-2-2)
package /Interfaces
  parameter interface User_Preferences_Interface: is-service=true
    parameter data prototype BRIGHTNESS_PRESET: type=BRIGHTNESS_PRESET_TYPE
    parameter data prototype PREFERRED_MODE: type=PREFERRED_MODE_TYPE
