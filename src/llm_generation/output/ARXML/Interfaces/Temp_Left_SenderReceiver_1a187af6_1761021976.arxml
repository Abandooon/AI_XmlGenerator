AUTOSAR XML (schema 4-2-2)
package /Interfaces
  sender receiver interface Temp_Left_SenderReceiver
    data Left_Sensor1_Temperature: type=float32
    data Left_Sensor2_Temperature: type=float32
    data Left_Seat_Fused_Temperature: type=float32
