AUTOSAR XML (schema 4-2-2)
package /Interfaces
  sender receiver interface CAN_Gateway_Interface
    data CAN_Frame_Rx: type=uint8
    data CAN_Frame_Tx: type=uint8
    data Gateway_Status: type=uint8
