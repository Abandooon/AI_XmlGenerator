AUTOSAR XML (schema 4-2-2)
package /Interfaces
  sender receiver interface CAN_Bus_IF
    4 x data:
      can_id: type=uint32
      dlc: type=uint8
      data: type=ByteArray8
      timestamp: type=uint32
