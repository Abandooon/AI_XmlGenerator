AUTOSAR XML (schema 4-2-2)
package /Interfaces
  client server interface BrakeActuator_Service: is-service=true
    operation BrakeCommand
    operation BrakeAck
    operation BrakeDiagnostic
