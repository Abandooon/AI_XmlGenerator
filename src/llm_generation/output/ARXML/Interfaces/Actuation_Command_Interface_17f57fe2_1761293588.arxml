AUTOSAR XML (schema 4-2-2)
package /Interfaces
  client server interface Actuation_Command_Interface: is-service=true
    operation SubmitActuationCommand
