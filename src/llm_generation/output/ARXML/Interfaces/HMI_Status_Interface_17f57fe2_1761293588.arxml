AUTOSAR XML (schema 4-2-2)
package /Interfaces
  client server interface HMI_Status_Interface: is-service=true
    operation RequestSystemStatus
