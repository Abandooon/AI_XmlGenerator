AUTOSAR XML (schema 4-2-2)
package /Interfaces
  client server interface IF_NavigationService: is-service=true
    operation RequestRoute
