AUTOSAR XML (schema 4-2-2)
package /Interfaces
  client server interface HeatCmd_ClientServer
    operation SetHeaterLevel
    operation GetPowerDriverStatus
