AUTOSAR XML (schema 4-2-2)
package /Interfaces
  sender receiver interface Radar_to_Fusion_SR
    data ObjectList: type=ObjectList
    data Timestamp: type=uint64
    data SensorMeta: type=SensorMeta
