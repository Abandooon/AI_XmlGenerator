AUTOSAR XML (schema 4-2-2)
package /Interfaces
  sender receiver interface Temp_SR
    data Temp_Celsius: type=float32
    data Overtemp_Flag: type=uint8
