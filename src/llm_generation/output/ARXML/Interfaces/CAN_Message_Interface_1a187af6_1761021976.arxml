AUTOSAR XML (schema 4-2-2)
package /Interfaces
  sender receiver interface CAN_Message_Interface
    data Set_Level_Command: type=HeaterLevel
    data Heater_Status_Report: type=HeaterStatus
    data Diagnostic_Message: type=DiagnosticMessage
