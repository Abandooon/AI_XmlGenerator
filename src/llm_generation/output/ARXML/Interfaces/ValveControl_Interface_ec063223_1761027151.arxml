AUTOSAR XML (schema 4-2-2)
package /Interfaces
  client server interface ValveControl_Interface: is-service=true
    operation SetValvePosition
    operation GetValveStatus
