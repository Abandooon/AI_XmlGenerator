AUTOSAR XML (schema 4-2-2)
package /Interfaces
  client server interface IF_Phone_Control: is-service=true
    operation PhoneControl
