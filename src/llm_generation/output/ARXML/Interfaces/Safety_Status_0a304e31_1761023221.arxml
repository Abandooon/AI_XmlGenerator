AUTOSAR XML (schema 4-2-2)
package /Interfaces
  sender receiver interface Safety_Status
    data SafetyMode: type=uint8
    data SafetyAlert: type=boolean
    data Component_Heartbeat: type=uint32
