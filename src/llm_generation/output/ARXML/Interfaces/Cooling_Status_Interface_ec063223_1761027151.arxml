AUTOSAR XML (schema 4-2-2)
package /Interfaces
  sender receiver interface Cooling_Status_Interface
    data CoolingStatus: type=CoolingStatus
