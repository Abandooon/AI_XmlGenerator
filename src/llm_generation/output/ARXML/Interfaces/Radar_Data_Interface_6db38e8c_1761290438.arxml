AUTOSAR XML (schema 4-2-2)
package /Interfaces
  sender receiver interface Radar_Data_Interface
    data Radar_Data: type=Radar_Data
