AUTOSAR XML (schema 4-2-2)
package /Interfaces
  sender receiver interface IF_MediaPlayback
    data audioStream: type=AudioStream
    data metadata: type=MediaMetadata
    data playbackControl: type=PlaybackControl
