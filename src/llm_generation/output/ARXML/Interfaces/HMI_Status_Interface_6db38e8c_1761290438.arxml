AUTOSAR XML (schema 4-2-2)
package /Interfaces
  sender receiver interface HMI_Status_Interface
    data ADAS_Status: type=ADAS_Status
