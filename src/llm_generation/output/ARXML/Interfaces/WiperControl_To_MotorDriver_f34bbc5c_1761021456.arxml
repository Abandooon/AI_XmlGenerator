AUTOSAR XML (schema 4-2-2)
package /Interfaces
  client server interface WiperControl_To_MotorDriver
    operation ControlCommand
