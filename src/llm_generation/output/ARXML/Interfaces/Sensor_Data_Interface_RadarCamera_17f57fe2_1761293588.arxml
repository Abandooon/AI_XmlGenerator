AUTOSAR XML (schema 4-2-2)
package /Interfaces
  sender receiver interface Sensor_Data_Interface_RadarCamera
    data RadarData: type=RadarData
    data CameraImageData: type=CameraImageData
    data Timestamp: type=Timestamp
