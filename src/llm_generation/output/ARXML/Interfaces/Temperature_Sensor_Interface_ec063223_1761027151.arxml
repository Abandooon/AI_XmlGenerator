AUTOSAR XML (schema 4-2-2)
package /Interfaces
  sender receiver interface Temperature_Sensor_Interface
    data TemperatureArray: type=TemperatureArray
    data SensorHealth: type=uint8
