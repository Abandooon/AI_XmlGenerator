AUTOSAR XML (schema 4-2-2)
package /Interfaces
  client server interface CAN_Send_Service: is-service=true
    operation SendBatteryState
