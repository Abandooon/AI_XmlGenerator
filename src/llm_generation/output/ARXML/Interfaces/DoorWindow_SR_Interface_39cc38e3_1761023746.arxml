AUTOSAR XML (schema 4-2-2)
package /Interfaces
  sender receiver interface DoorWindow_SR_Interface
    data WindowPosition: type=sint16
    data WindowState: type=uint8
    data WindowCommandAck: type=boolean
