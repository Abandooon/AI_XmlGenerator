AUTOSAR XML (schema 4-2-2)
package /Interfaces
  sender receiver interface Fusion_Data_Interface
    data Fused_Data: type=Fused_Data
