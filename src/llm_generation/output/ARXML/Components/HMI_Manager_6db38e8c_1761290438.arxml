AUTOSAR XML (schema 4-2-2)
package /Components
  nv block sw component type HMI_Manager
    require port R_Port_HMI_Status: required-interface=HMI_Status_Interface
