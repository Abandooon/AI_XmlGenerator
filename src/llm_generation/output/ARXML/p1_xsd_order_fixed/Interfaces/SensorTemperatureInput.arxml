AUTOSAR XML (schema 4-2-2)
package /Interfaces
  sender receiver interface SensorTemperatureInput
    data SensorTemperature: type=sint16
