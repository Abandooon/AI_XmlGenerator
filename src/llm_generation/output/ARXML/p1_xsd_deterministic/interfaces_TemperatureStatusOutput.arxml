AUTOSAR XML (schema 4-2-2)
package /Interfaces
  sender receiver interface TemperatureStatusOutput
    data TemperatureStatus: type=uint8
