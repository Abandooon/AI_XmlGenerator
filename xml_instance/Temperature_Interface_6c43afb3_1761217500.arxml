AUTOSAR XML (schema 4-2-2)
package /Interfaces
  sender receiver interface Temperature_Interface
    data temperatures: type=temperatures
    data hotspotIndex: type=uint8
