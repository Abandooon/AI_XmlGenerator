AUTOSAR XML (schema 4-2-2)
package /Interfaces
  8 x sender receiver interface:
    Control_Command_IF
      data engine_actuation_cmd_out: type=float32
      data gear_command_out: type=uint8
      data regen_actuation_cmd_out: type=float32
    Engine_Torque_Capability_IF
      data engine_torque_capability_nm: type=float32
    Gear_Command_IF
      data gear_cmd: type=uint8
    Regen_Torque_Capability_IF
      data regen_torque_capability_nm: type=float32
    Torque_Command_IF
      data engine_torque_cmd_nm: type=float32
      data trans_torque_cmd_nm: type=float32
      data regen_torque_cmd_nm: type=float32
    Torque_Request_IF
      data driver_torque_request_nm: type=float32
    Transmission_Torque_Capability_IF
      data trans_torque_capability_nm: type=float32
    UDS_Frame_IF
      data uds_request_frame: type=uint8
      data uds_response_frame: type=uint8
  client server interface UDS_Service_IF: is-service=true
    operation read_did
    operation write_did
    operation routine_control
  sender receiver interface Vehicle_Status_IF
    data vehicle_speed_kph: type=float32
    data brake_status: type=boolean
    data engine_rpm: type=uint16
