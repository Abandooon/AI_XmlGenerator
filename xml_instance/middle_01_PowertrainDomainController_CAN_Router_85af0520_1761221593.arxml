AUTOSAR XML
package /DataTypes
  app type SpeedDataType: sw-data-def-props-content={value-axis-data-type=BaseSpeedType, compu-method=SpeedCompu, unit=KmPerHour, base-type=Float32}
  app type TemperatureDataType: sw-data-def-props-content={compu-method=TempCompu, unit=Celsius, base-type=Float32}
  app type PressureDataType: sw-data-def-props-content=BasePressureType
