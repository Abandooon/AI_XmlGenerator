AUTOSAR XML (schema 4-2-2)
package /Interfaces
  sender receiver interface CAN_Tx_Interface
    data CAN_Frame: type=CAN_Frame
