AUTOSAR XML (schema 4-2-2)
package /Interfaces
  sender receiver interface Safety_Interface
    data safetyLimits: type=safetyLimits
    data safetyEvent: type=safetyEvent
