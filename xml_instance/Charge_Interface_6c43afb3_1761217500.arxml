AUTOSAR XML (schema 4-2-2)
package /Interfaces
  client server interface Charge_Interface
    operation ChargeRequest
    operation ChargeResponse
