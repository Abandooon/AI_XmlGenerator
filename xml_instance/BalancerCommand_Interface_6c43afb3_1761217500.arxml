AUTOSAR XML (schema 4-2-2)
package /Interfaces
  client server interface BalancerCommand_Interface
    operation BalanceCommand
    operation BalanceAck
