AUTOSAR XML (schema 4-2-2)
package /Interfaces
  sender receiver interface Gear_Command_IF
    data gear_cmd: type=uint8
