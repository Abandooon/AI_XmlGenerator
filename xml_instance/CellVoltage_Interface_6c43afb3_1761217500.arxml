AUTOSAR XML (schema 4-2-2)
package /Interfaces
  sender receiver interface CellVoltage_Interface
    data cellVoltages: type=cellVoltages
    data packVoltage: type=float32
    data cellVoltageSummary: type=cellVoltageSummary
