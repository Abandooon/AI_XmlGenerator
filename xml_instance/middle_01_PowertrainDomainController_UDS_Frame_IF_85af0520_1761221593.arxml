AUTOSAR XML (schema 4-2-2)
package /Interfaces
  sender receiver interface UDS_Frame_IF
    data uds_request_frame: type=uint8
    data uds_response_frame: type=uint8
