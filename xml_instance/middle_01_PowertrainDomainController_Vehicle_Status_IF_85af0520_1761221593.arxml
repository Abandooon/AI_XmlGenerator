AUTOSAR XML (schema 4-2-2)
package /Interfaces
  sender receiver interface Vehicle_Status_IF
    data vehicle_speed_kph: type=float32
    data brake_status: type=boolean
    data engine_rpm: type=uint16
